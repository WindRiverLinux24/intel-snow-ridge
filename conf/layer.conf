## conf/layer.conf
```bitbake
#
# Copyright (C) 2024 Wind River Systems, Inc.
#

# We have a conf and classes directory, add to BBPATH
BBPATH =. "${LAYERDIR}:"

# We have a packages directory, add to BBFILES
BBFILES += "${LAYERDIR}/recipes-*/*/*.bb \
	${LAYERDIR}/recipes-*/*/*.bbappend"

BBFILE_COLLECTIONS += "wr-intel-snow-ridge"
BBFILE_PATTERN_wr-intel-snow-ridge = "^${LAYERDIR}/"
BBFILE_PRIORITY_wr-intel-snow-ridge = "8"

# This should only be incremented on significant changes that will
# cause compatibility issues with other layers
LAYERVERSION_wr-intel-snow-ridge = "1"

LAYERDEPENDS_wr-intel-snow-ridge = "core wrlinux intel intel-x86"

LAYERSERIES_COMPAT_wr-intel-snow-ridge = "wrl scarthgap"

LAYER_PATH_wr-intel-snow-ridge = "${LAYERDIR}"
```

## conf/machine/intel-snow-ridge.conf
```bitbake
#
# Copyright (C) 2024 Wind River Systems, Inc.
#
#@TYPE: Machine
#@NAME: intel-snow-ridge
#@DESCRIPTION: Machine configuration for Intel Snow Ridge

DEFAULTTUNE ?= "corei7-64"
require conf/machine/include/x86/tune-corei7.inc
require conf/machine/intel-x86.inc

# multilib support
MULTILIBS ?= "multilib:lib32"
DEFAULTTUNE:virtclass-multilib-lib32 ?= "corei7-32"

SERIAL_CONSOLES = "115200;ttyS4"

# wks file for Intel Snow Ridge
WKS_FILE = "intel-snowridge-mkefidisk.wks.in"

# Package qat17 can be used on Intel Snow Ridge
COMPATIBLE_MACHINE:pn-qat17 = "intel-snow-ridge"
```
